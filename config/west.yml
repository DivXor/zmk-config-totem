## config/west.yml
```yaml
manifest:
  remotes:
    - name: zmkfirmware
      url-base: https://github.com/zmkfirmware
    # - name: caksoylar
    #   url-base: https://github.com/caksoylar
    # - name: carrefinho
    #   url-base: https://github.com/carrefinho
    - name: urob
      url-base: https://github.com/urob
    - name: janpfischer
      url-base: https://github.com/janpfischer
  projects:
    - name: zmk
      remote: urob
      revision: main
      import: app/west.yml
    # - name: zmk-rgbled-widget
    #   remote: caksoylar
    #   revision: main
    # - name: prospector-zmk-module
    #   remote: carrefinho
    #   revision: main
    - name: zmk-dongle-screen
      remote: janpfischer
      revision: main
    - name: zmk-helpers
      remote: urob
      revision: main
  self:
    path: config
```
